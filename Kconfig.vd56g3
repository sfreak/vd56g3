## Kconfig.vd56g3
```kconfig
menuconfig CAMERA_VD56G3
    bool "VD56G3"
    default n
    depends on SOC_MIPI_CSI_SUPPORTED
    help
        Enable support for the VD56G3 CMOS image sensor.

if CAMERA_VD56G3
    menu "Auto detect VD56G3"
        config CAMERA_VD56G3_AUTO_DETECT_MIPI_INTERFACE_SENSOR
            bool "Detect for MIPI CSI interface sensor"
            default y
            help
                When enabled, the VD56G3 sensor will be automatically detected
                and initialized on the MIPI CSI interface at startup without requiring
                manual detection call(vd56g3_detect) in your application.
    endmenu

    menu "Choose supported formats for MIPI CSI interface"
        config CAMERA_VD56G3_MIPI_RAW10_1120x1360_88FPS
            bool "MIPI 2-lane, 12M input,  1120x1360 88fps, RAW10"
            default y
            help
                RAW10 monochrome format at 1120x1360 resolution with 88fps framerate.
                Requires MIPI CSI-2 2-lane interface with 12MHz input clock.
        config CAMERA_VD56G3_MIPI_RAW8_1120x1360_88FPS
            bool "MIPI 2-lane, 12M input,  1120x1360 88fps, RAW8"
            default y
            help
                RAW8 monochrome format at 1120x1360 resolution with 88fps framerate.
                Requires MIPI CSI-2 2-lane interface with 12MHz input clock.
        config CAMERA_VD56G3_MIPI_RAW8_480x640_88FPS
            bool "MIPI 2-lane, 12M input,  480x640 88fps, RAW8"
            default y
            help
                RAW8 monochrome format at 480x640 resolution with 88fps framerate.
                Requires MIPI CSI-2 2-lane interface with 12MHz input clock.
    endmenu

    choice CAMERA_VD56G3_MIPI_DEFAULT_FMT
        prompt "Select default output format for MIPI CSI interface"
        default CAMERA_VD56G3_MIPI_DEFAULT_FMT_RAW10_1120x1360_88FPS
        help
            This option allows you to select the default video format for the VD56G3 sensor
            when it is initialized on the MIPI CSI interface. The selected format will be used
            when the sensor is detected and initialized, and can be changed later when the
            sensor is in stream off state.

        config CAMERA_VD56G3_MIPI_DEFAULT_FMT_RAW10_1120x1360_88FPS
            bool "MIPI 2-lane, 12M input,  1120x1360 88fps, RAW10"
            depends on CAMERA_VD56G3_MIPI_RAW10_1120x1360_88FPS

        config CAMERA_VD56G3_MIPI_DEFAULT_FMT_RAW8_1120x1360_88FPS
            bool "MIPI 2-lane, 12M input,  1120x1360 88fps, RAW8"
            depends on CAMERA_VD56G3_MIPI_RAW8_1120x1360_88FPS

        config CAMERA_VD56G3_MIPI_DEFAULT_FMT_RAW8_480x640_88FPS
            bool "MIPI 2-lane, 12M input,  480x640 88fps, RAW8"
            depends on CAMERA_VD56G3_MIPI_RAW8_480x640_88FPS

    endchoice # CAMERA_VD56G3_MIPI_DEFAULT_FMT

    config CAMERA_VD56G3_MIPI_IF_FORMAT_INDEX_DEFAULT
        int
        default 0 if CAMERA_VD56G3_MIPI_DEFAULT_FMT_RAW10_1120x1360_88FPS
        default 1 if CAMERA_VD56G3_MIPI_DEFAULT_FMT_RAW8_1120x1360_88FPS
        default 2 if CAMERA_VD56G3_MIPI_DEFAULT_FMT_RAW8_480x640_88FPS
        help
            Sets the default configuration for the MIPI CSI interface.
            Use query_support_formats() API to get more format options.

endif
```
